## main/Kconfig.projbuild
```kconfig
menu "Pametni alarm"

    config ALARM_WIFI_SSID
        string "Podrazumevani WiFi SSID"
        default "Wokwi-GUEST"
        help
            Ime WiFi mreže koje se upisuje u NVS pri prvom pokretanju,
            ako u NVS-u još nema sačuvanih podataka. Posle toga uređaj
            podatke uvek čita iz NVS-a.

    config ALARM_WIFI_PASSWORD
        string "Podrazumevana WiFi lozinka"
        default ""
        help
            Lozinka WiFi mreže koja se upisuje u NVS pri prvom pokretanju.
            Prazno znači otvorena mreža (npr. Wokwi-GUEST u simulatoru).

    config ALARM_DEVICE_ID
        string "ID uređaja"
        default "alarm-01"
        help
            Jedinstveno ime uređaja. Koristi se kao MQTT client ID
            i kao deo MQTT tema.

    config ALARM_MQTT_BROKER_URI
        string "Adresa MQTT brokera"
        default "mqtt://broker.hivemq.com"
        help
            Adresa MQTT brokera, npr. mqtt://192.168.1.10:1883.
            Podrazumevano je javni test broker (samo za testiranje).

    config ALARM_MQTT_TOPIC_ROOT
        string "Početak MQTT tema"
        default "smart_alarm"
        help
            Teme su oblika <početak>/<ID uređaja>/events, /status i /cmd.

endmenu
```
